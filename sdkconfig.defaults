## sdkconfig.defaults
```kconfig
# --- 目标芯片 ---
CONFIG_IDF_TARGET="esp32c3"
# 注:ESP32-C3 无 PSRAM,故不设 CONFIG_SPIRAM。

# --- Flash ---
# FoloToy AI Passport 的所有硬件批次均使用 8MB Flash。
CONFIG_ESPTOOLPY_FLASHSIZE_8MB=y
# 烧录时按实际探测容量回写镜像头。
CONFIG_ESPTOOLPY_HEADER_FLASHSIZE_UPDATE=y
# 自定义分区表(含 SPIFFS 数据区用于存放电子书)
CONFIG_PARTITION_TABLE_CUSTOM=y
CONFIG_PARTITION_TABLE_CUSTOM_FILENAME="partitions.csv"
CONFIG_PARTITION_TABLE_CUSTOM_APP_BIN_OFFSET=0x10000
CONFIG_PARTITION_TABLE_FILENAME="partitions.csv"

# --- 控制台:USB-Serial-JTAG(C3 原生 USB,GPIO18/19)---
# 不用 UART0:其默认 TX=GPIO21 与本板背光引脚冲突。
CONFIG_ESP_CONSOLE_USB_SERIAL_JTAG=y
CONFIG_ESP_CONSOLE_SECONDARY_NONE=y

# --- LVGL ---
CONFIG_LV_COLOR_DEPTH_16=y
CONFIG_LV_FONT_MONTSERRAT_14=y
CONFIG_LV_FONT_MONTSERRAT_20=y
# LVGL 内置 malloc 池大小(KB)。它是独立静态区、不与系统堆共享,配大了会白白占用 RAM。
# 本 demo UI 简单,24KB 足够;若自建复杂界面出现绘制卡死/看门狗,调大此值。
CONFIG_LV_MEM_SIZE_KILOBYTES=24

# --- 系统 ---
CONFIG_FREERTOS_HZ=1000
# app_main 里要跑开机动画(SPIFFS fopen/opendir/fread),默认 3584 偏小,留足余量防栈溢出重启。
CONFIG_ESP_MAIN_TASK_STACK_SIZE=16384

# --- NVS (阅读进度保存) ---
CONFIG_NVS_ENABLE_NEW_DESIGN=y
CONFIG_NVS_PAGE_PAIR_COUNT=2

# --- SPIFFS (电子书存储) ---
CONFIG_FATFS_VOLUME_COUNT=0
CONFIG_SPIFFS=y
CONFIG_SPIFFS_MAX_PARTITIONS=3
CONFIG_SPIFFS_CACHE=y
CONFIG_SPIFFS_CACHE_WR=y
CONFIG_SPIFFS_PAGE_CHECK=y
CONFIG_SPIFFS_GC_MAX_RUNS=10
CONFIG_SPIFFS_OBJ_NAME_LEN=32
CONFIG_SPIFFS_USE_MAGIC=y
CONFIG_SPIFFS_USE_MAGIC_LENGTH=y
CONFIG_SPIFFS_META_LENGTH=4
CONFIG_SPIFFS_USE_MTIME=y

# --- 网络(WiFi + HTTPS AI 请求) ---
# 全局证书包:验证 uuapi.io 等主流 CA 签发的 TLS 证书
CONFIG_MBEDTLS_CERTIFICATE_BUNDLE=y
CONFIG_MBEDTLS_CERTIFICATE_BUNDLE_DEFAULT_FULL=y
CONFIG_ESP_TLS_INSECURE=n

# --- WiFi 缓冲区(配网模式最小化) ---
CONFIG_ESP_WIFI_STATIC_RX_BUFFER_NUM=4
CONFIG_ESP_WIFI_DYNAMIC_RX_BUFFER_NUM=16
CONFIG_ESP_WIFI_STATIC_TX_BUFFER_NUM=2
CONFIG_ESP_WIFI_DYNAMIC_TX_BUFFER_NUM=4
CONFIG_ESP_WIFI_AMSDU_TX_ENABLE=n
CONFIG_ESP_WIFI_AMPDU_RX_ENABLE=n

# --- LWIP/TCP(配网优化) ---
CONFIG_LWIP_TCP_MSS=536
CONFIG_LWIP_TCP_SND_BUF_DEFAULT=2920
CONFIG_LWIP_TCP_WND_DEFAULT=2920
CONFIG_LWIP_MAX_SOCKETS=4

# --- HTTP 服务器(配网精简) ---
CONFIG_HTTPD_MAX_REQ_HDR_LEN=512
CONFIG_HTTPD_MAX_URI_LEN=256
CONFIG_HTTPD_ERR_RESP_NO_DELAY=y
```
